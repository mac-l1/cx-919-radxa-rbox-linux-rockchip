## drivers/net/wireless/rtl8723bs/Kconfig
```kconfig
config RTL8723BS
	tristate "Realtek 8723B SDIO or SPI WiFi"
	depends on WLAN
	select WIRELESS_EXT
	select WEXT_PRIV
	select IEEE80211
	---help---
	  Help message of RTL8723BS
```
